## ble-foreva/esp32/sdkconfig.defaults
```kconfig
CONFIG_IDF_TARGET="esp32s3"
CONFIG_BT_ENABLED=y
CONFIG_BT_NIMBLE_ENABLED=y
CONFIG_BT_NIMBLE_ROLE_OBSERVER=y
# CONFIG_BT_NIMBLE_ROLE_BROADCASTER is not set
# CONFIG_BT_NIMBLE_ROLE_PERIPHERAL is not set
# CONFIG_BT_NIMBLE_ROLE_CENTRAL is not set
CONFIG_ESP_CONSOLE_USB_SERIAL_JTAG=y
CONFIG_ESP_CONSOLE_SECONDARY_NONE=y
```

## components/ota_decrypt/Kconfig
```kconfig
config BLE_LOCK_ENCRYPTED_OTA
    bool
    default y
    select ESP_HTTPS_OTA_DECRYPT_CB
```

## main/Kconfig.projbuild
```kconfig
menu "BLE Lock security finalization"

config APP_FINALIZE_ROM_DOWNLOAD_AFTER_OTA
    bool "Disable ROM Download after a healthy OTA boot"
    default n
    depends on SECURE_BOOT && SECURE_FLASH_ENC_ENABLED && NVS_ENCRYPTION && NVS_SEC_KEY_PROTECT_USING_HMAC && BOOTLOADER_APP_ROLLBACK_ENABLE
    help
        After a pending OTA image passes NVS, ULP calibration/fault, and BLE
        initialization checks and is marked valid, permanently disable ROM
        Download Mode. This is irreversible; keep disabled for normal profiles.

endmenu
```

## sdkconfig.defaults.esp32s3
```kconfig
# Дополнительные настройки именно для ESP32-S3
CONFIG_BT_ENABLED=y
CONFIG_BT_NIMBLE_ENABLED=y
CONFIG_BT_NIMBLE_HOST_TASK_STACK_SIZE=8192
CONFIG_BT_NIMBLE_MAX_CONNECTIONS=7
CONFIG_BT_CTRL_BLE_MAX_ACT=7
CONFIG_BT_NIMBLE_MAX_BONDS=20
CONFIG_BT_NIMBLE_NVS_PERSIST=y
CONFIG_BT_NIMBLE_SM_LEGACY=n
CONFIG_BT_NIMBLE_SM_SC=y
CONFIG_BT_NIMBLE_SM_LVL=2
# CONFIG_BT_NIMBLE_SM_SC_ONLY is not set
CONFIG_BT_NIMBLE_ROLE_OBSERVER=y
# CONFIG_BT_NIMBLE_ROLE_BROADCASTER is not set
# CONFIG_BT_NIMBLE_ROLE_PERIPHERAL is not set
CONFIG_BT_NIMBLE_ROLE_CENTRAL=y
CONFIG_ESP_COEX_SW_COEXIST_ENABLE=y

# ULP RISC-V solenoid controller
CONFIG_ULP_COPROC_ENABLED=y
CONFIG_ULP_COPROC_TYPE_RISCV=y
CONFIG_ULP_COPROC_RESERVE_MEM=5120
CONFIG_ULP_RISCV_INTERRUPT_ENABLE=y
CONFIG_ESP_SYSTEM_EVENT_TASK_STACK_SIZE=4096
```

## ulp_lock_controller/sdkconfig.defaults
```kconfig
CONFIG_IDF_TARGET="esp32s3"
CONFIG_FREERTOS_HZ=1000
CONFIG_ULP_COPROC_ENABLED=y
CONFIG_ULP_COPROC_TYPE_RISCV=y
CONFIG_ULP_COPROC_RESERVE_MEM=4096
CONFIG_ULP_RISCV_INTERRUPT_ENABLE=y
```
